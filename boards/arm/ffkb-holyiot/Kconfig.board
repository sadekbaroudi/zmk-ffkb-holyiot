## boards/arm/ffkb-holyiot/Kconfig.board
```kconfig
# Zaphod board configuration

# Copyright (c) 2020 Pete Johanson
# SPDX-License-Identifier: MIT

config FFKB_HOLYIOT
	bool "ffkb-holyiot"
	depends on SOC_NRF52840_QIAA
```

## config/boards/shields/ffkb-holyiot/Kconfig.defconfig
```kconfig
# Copyright (c) 2021 The ZMK Contributors
# SPDX-License-Identifier: MIT

if SHIELD_FFKB_HOLYIOT

config ZMK_KEYBOARD_NAME
    default "ffkb-holyiot"

endif

CONFIG_SOC_SERIES_NRF52X=y
CONFIG_SOC_NRF52840_QIAA=y

# Enable MPU
CONFIG_ARM_MPU=y

# enable GPIO
CONFIG_GPIO=y
```

## west.yml
```yaml
manifest:
  remotes:
    - name: zmkfirmware
      url-base: https://github.com/zmkfirmware
    - name: sadekbaroudi
      url-base: https://github.com/sadekbaroudi
  projects:
    - name: zmk
      remote: zmkfirmware
      revision: main
      import: app/west.yml
  self:
    path: config
```
